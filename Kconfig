## Kconfig
```kconfig
#
# For a description of the syntax of this configuration file,
# see Documentation/kbuild/kconfig-language.txt.
#
mainmenu "Linux/$ARCH $KERNELVERSION Kernel Configuration"

config SRCARCH
	string
	option env="SRCARCH"

source "arch/$SRCARCH/Kconfig"

config CABLE_DETECT_8X55
boolean "Cable detect driver"
default n
help
Detect usb, ac and other accessories.

config CABLE_DETECT_ACCESSORY
boolean "CABLE ACCESSORY DETECT"
default n

config CABLE_DETECT_ACCESSORY_BY_ADC
boolean "DETECT ACCESSORY BY PMIC ADC"
default n
```

## arch/microblaze/Kconfig.rej
```kconfig
--- arch/microblaze/Kconfig
+++ arch/microblaze/Kconfig
@@ -57,7 +57,7 @@
 	def_bool y
 
 config GENERIC_GPIO
-	def_bool y
+	bool
 
 config GENERIC_CSUM
 	def_bool y
```

## arch/sparc/Kconfig.rej
```kconfig
--- arch/sparc/Kconfig
+++ arch/sparc/Kconfig
@@ -584,6 +584,9 @@
 	depends on COMPAT && SYSVIPC
 	default y
 
+config KEYS_COMPAT
+	def_bool y if COMPAT && KEYS
+
 endmenu
 
 source "net/Kconfig"
```

## block/Kconfig.iosched.rej
```kconfig
--- block/Kconfig.iosched
+++ block/Kconfig.iosched
@@ -53,6 +53,16 @@
 	  basic merging, trying to keep a minimum overhead. It is aimed
 	  mainly for aleatory access devices (eg: flash devices).
 
+config IOSCHED_SIOPLUS
+	tristate "Simple I/O scheduler plus"
+	default y
+	---help---
+	  The Simple I/O scheduler is an extremely simple scheduler,
+	  based on noop and deadline, that relies on deadlines to
+	  ensure fairness. The algorithm does not do any sorting but
+	  basic merging, trying to keep a minimum overhead. It is aimed
+	  mainly for aleatory access devices (eg: flash devices).
+
 config IOSCHED_VR
 	tristate "V(R) I/O scheduler"
 	default n
@@ -151,6 +161,9 @@
 	config DEFAULT_SIO
 		bool "SIO" if IOSCHED_SIO=y
 
+	config DEFAULT_SIOPLUS
+		bool "SIOPLUS" if IOSCHED_SIOPLUS=y
+
  	config DEFAULT_VR
 		bool "VR" if IOSCHED_VR=y
 
@@ -171,6 +184,7 @@
 	default "bfq" if DEFAULT_BFQ
 	default "noop" if DEFAULT_NOOP
 	default "sio" if DEFAULT_SIO
+	default "sioplus" if DEFAULT_SIOPLUS
 	default "vr" if DEFAULT_VR
 
 endmenu
```

## drivers/mtd/Kconfig.rej
```kconfig
--- drivers/mtd/Kconfig
+++ drivers/mtd/Kconfig
@@ -128,7 +128,7 @@
 
 config MTD_OF_PARTS
 	tristate "OpenFirmware partitioning information support"
-	default Y
+	default y
 	depends on OF
 	help
 	  This provides a partition parsing function which derives
```
